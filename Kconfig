## Kconfig.platform
```kconfig
config PLATFORM
	string "platform"
	default "native"
	help
	Plz input platform name: "native", etc
```

## src/Kconfig
```kconfig
menu "main"

config DP_EXTRA_CFLAGS
	string "extra cflags"
	default ""

config DP_EXTRA_LDFLAGS
	string "extra ldflags"
	default ""

config DP_LOCK_PATH
	string "Default file lock path"
	default "/var/run/.template.deleteme.lock"

endmenu

#;
```
